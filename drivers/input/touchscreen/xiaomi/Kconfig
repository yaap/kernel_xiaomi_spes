## drivers/input/touchscreen/xiaomi/Kconfig
```kconfig
config TOUCHSCREEN_XIAOMI_TOUCHFEATURE
	tristate "Xiaomi Touch Feature"
	depends on TOUCHSCREEN_COMMON
	help
	  Say Y here if you enable xiaomi touch feature.
	  If unsure, say N.
	  To compile this driver as a module, choose M here.
```
